## app/boards/arm/glove80/Kconfig.board
```kconfig
# Copyright (c) 2021 The ZMK Contributors
# SPDX-License-Identifier: MIT

config BOARD_GLOVE80_LH
    bool "Glove80 LH"
    depends on SOC_NRF52840_QIAA

config BOARD_GLOVE80_RH
    bool "Glove80 RH"
    depends on SOC_NRF52840_QIAA

config BOARD_GLOVE80_LH_DONGLE
    bool "Glove80 LH Dongle"
    depends on SOC_NRF52840_QIAA

config BOARD_GLOVE80_DONGLE
    bool "Glove80 Dongle"
    depends on SOC_NRF52840_QIAA
```
